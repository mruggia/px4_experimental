## src/modules/flifo_att_control/Kconfig
```kconfig
menuconfig MODULES_FLIFO_ATT_CONTROL
	bool "flifo_att_control"
	default y
	---help---
		Enable support for flifo_att_control

menuconfig USER_FLIFO_ATT_CONTROL
	bool "flifo_att_control running as userspace module"
	default y
	depends on BOARD_PROTECTED && MODULES_FLIFO_ATT_CONTROL
	---help---
		Put flifo_att_control in userspace memory
```

## src/modules/flifo_control/Kconfig
```kconfig
menuconfig MODULES_FLIFO_CONTROL
	bool "flifo_control"
	default y
	---help---
		Enable support for flifo_control

menuconfig USER_FLIFO_CONTROL
	bool "flifo_control running as userspace module"
	default y
	depends on BOARD_PROTECTED && MODULES_FLIFO_CONTROL
	---help---
		Put flifo_control in userspace memory
```
